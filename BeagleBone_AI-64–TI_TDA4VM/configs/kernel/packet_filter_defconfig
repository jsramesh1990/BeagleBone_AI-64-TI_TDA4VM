## BeagleBone_AI-64–TI_TDA4VM/configs/kernel/packet_filter_defconfig
```kconfig
#
# BeagleBone AI-64 / TI TDA4VM
# Advanced Linux Packet Filter Driver
#

# ---------------------------------------------------------------------------
# Loadable Kernel Modules
# ---------------------------------------------------------------------------
CONFIG_MODULES=y
CONFIG_MODULE_UNLOAD=y
CONFIG_MODVERSIONS=y

# ---------------------------------------------------------------------------
# Networking
# ---------------------------------------------------------------------------
CONFIG_NET=y
CONFIG_INET=y
CONFIG_NETDEVICES=y
CONFIG_NET_CORE=y

# ---------------------------------------------------------------------------
# Packet Socket
# ---------------------------------------------------------------------------
CONFIG_PACKET=y

# ---------------------------------------------------------------------------
# Netfilter
# ---------------------------------------------------------------------------
CONFIG_NETFILTER=y
CONFIG_NETFILTER_ADVANCED=y

CONFIG_NETFILTER_NETLINK=y
CONFIG_NETFILTER_XTABLES=y

# IPv4 Netfilter
CONFIG_INET=y
CONFIG_NETFILTER_XT_TARGET_LOG=m
CONFIG_NETFILTER_XT_MATCH_MARK=m
CONFIG_NETFILTER_XT_MATCH_MULTIPORT=m

# ---------------------------------------------------------------------------
# Ethernet / Network Support
# ---------------------------------------------------------------------------
CONFIG_ETHERNET=y

# ---------------------------------------------------------------------------
# Character Device Support
# ---------------------------------------------------------------------------
CONFIG_CHARDEV=y

# ---------------------------------------------------------------------------
# Sysfs / Device Model
# ---------------------------------------------------------------------------
CONFIG_SYSFS=y
CONFIG_PROC_FS=y

# ---------------------------------------------------------------------------
# DebugFS
# ---------------------------------------------------------------------------
CONFIG_DEBUG_FS=y

# ---------------------------------------------------------------------------
# Dynamic Debug
# ---------------------------------------------------------------------------
CONFIG_DYNAMIC_DEBUG=y

# ---------------------------------------------------------------------------
# Kernel Symbols
# ---------------------------------------------------------------------------
CONFIG_KALLSYMS=y
CONFIG_KALLSYMS_ALL=y

# ---------------------------------------------------------------------------
# Kernel Tracing / Debugging
# ---------------------------------------------------------------------------
CONFIG_FTRACE=y
CONFIG_FUNCTION_TRACER=y
CONFIG_FUNCTION_GRAPH_TRACER=y

# ---------------------------------------------------------------------------
# Networking Diagnostics
# ---------------------------------------------------------------------------
CONFIG_NET_SCHED=y
CONFIG_NET_CLS_ACT=y
CONFIG_NET_CLS_BASIC=m

# ---------------------------------------------------------------------------
# RCU
# ---------------------------------------------------------------------------
CONFIG_TREE_RCU=y
CONFIG_PREEMPT_RCU=y

# ---------------------------------------------------------------------------
# Lock Debugging - useful during development
# ---------------------------------------------------------------------------
CONFIG_DEBUG_KERNEL=y
CONFIG_DEBUG_MUTEXES=y
CONFIG_DEBUG_SPINLOCK=y
CONFIG_DEBUG_LOCK_ALLOC=y
```

## BeagleBone_AI-64–TI_TDA4VM/yocto/meta-packet-filter/conf/layer.conf
```bitbake
# ============================================================
# meta-packet-filter
# Yocto layer configuration
# ============================================================

BBPATH .= ":${LAYERDIR}"

BBFILES += "${LAYERDIR}/recipes-*/*/*.bb"
BBFILES += "${LAYERDIR}/recipes-*/*/*.bbappend"

BBFILE_COLLECTIONS += "packet-filter"

BBFILE_PATTERN_packet-filter = "^${LAYERDIR}/"

BBFILE_PRIORITY_packet-filter = "7"

LAYERDEPENDS_packet-filter = "core"

LAYERSERIES_COMPAT_packet-filter = "scarthgap"
```
